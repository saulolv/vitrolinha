## tests/card/testcase.yaml
```yaml
tests:
  vitrolinha.card:
    tags:
      - vitrolinha
      - card
      - storage
    platform_allow:
      - native_sim
    integration_platforms:
      - native_sim
```

## tests/cmd/testcase.yaml
```yaml
tests:
  vitrolinha.cmd:
    tags:
      - vitrolinha
      - cmd
    platform_allow:
      - native_sim
    integration_platforms:
      - native_sim
```

## tests/seqlock/testcase.yaml
```yaml
tests:
  vitrolinha.seqlock:
    tags:
      - vitrolinha
      - seqlock
    platform_allow:
      - native_sim
    integration_platforms:
      - native_sim
```

## tests/sim_encoder/testcase.yaml
```yaml
tests:
  vitrolinha.sim_encoder:
    tags:
      - vitrolinha
      - sim_encoder
    platform_allow:
      - native_sim
    integration_platforms:
      - native_sim
```

## tests/snapshot/testcase.yaml
```yaml
tests:
  vitrolinha.snapshot:
    tags:
      - vitrolinha
      - snapshot
    platform_allow:
      - native_sim
    integration_platforms:
      - native_sim
```

## tests/storage/testcase.yaml
```yaml
tests:
  vitrolinha.storage:
    tags:
      - vitrolinha
      - storage
    platform_allow:
      - native_sim
    integration_platforms:
      - native_sim
```

## tests/storage_card/testcase.yaml
```yaml
tests:
  vitrolinha.storage_card:
    tags:
      - vitrolinha
      - storage
      - card
    platform_allow:
      - native_sim
    integration_platforms:
      - native_sim
```

## tests/track/testcase.yaml
```yaml
tests:
  vitrolinha.track:
    tags:
      - vitrolinha
      - track
    platform_allow:
      - native_sim
    integration_platforms:
      - native_sim
```
