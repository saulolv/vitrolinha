## tests/auto_advance/testcase.yaml
```yaml
tests:
  vitrolinha.auto_advance:
    tags:
      - vitrolinha
      - playback
    platform_allow:
      - native_sim
      - native_sim/native/64
    integration_platforms:
      - native_sim/native/64
```

## tests/buttons/testcase.yaml
```yaml
tests:
  vitrolinha.buttons:
    tags:
      - vitrolinha
      - input
    platform_allow:
      - native_sim
    integration_platforms:
      - native_sim
```

## tests/display/testcase.yaml
```yaml
tests:
  vitrolinha.display:
    tags:
      - vitrolinha
      - display
    platform_allow:
      - native_sim
      - native_sim/native/64
    integration_platforms:
      - native_sim/native/64
```

## tests/last_track/testcase.yaml
```yaml
tests:
  vitrolinha.last_track:
    tags:
      - vitrolinha
      - settings
    platform_allow:
      - native_sim
      - native_sim/native/64
    integration_platforms:
      - native_sim/native/64
```

## tests/library/testcase.yaml
```yaml
tests:
  vitrolinha.library:
    tags:
      - vitrolinha
      - storage
    platform_allow:
      - native_sim
    integration_platforms:
      - native_sim
```

## tests/library_card/testcase.yaml
```yaml
tests:
  vitrolinha.library_card:
    tags:
      - vitrolinha
      - storage
      - card
    platform_allow:
      - native_sim
    integration_platforms:
      - native_sim
```

## tests/parser_csv/testcase.yaml
```yaml
tests:
  vitrolinha.parser_csv:
    tags:
      - vitrolinha
      - parser_csv
    platform_allow:
      - native_sim
      - native_sim/native/64
    integration_platforms:
      - native_sim/native/64
```

## tests/player_first_command/testcase.yaml
```yaml
# Um cenário por primeiro comando. Valores de enum cmd_kind:
# 0 = CMD_PLAY_PAUSE, 1 = CMD_NEXT, 2 = CMD_PREV.
common:
  tags:
    - vitrolinha
    - player
  platform_allow:
    - native_sim
    - native_sim/native/64
  integration_platforms:
    - native_sim/native/64

tests:
  vitrolinha.player_first_command.empty_library:
    extra_configs:
      - CONFIG_TEST_CARD=n
      - CONFIG_TEST_EXPECTED_TRACK=-1
  vitrolinha.player_first_command.play:
    extra_configs:
      - CONFIG_TEST_FIRST_COMMAND=0
      - CONFIG_TEST_EXPECTED_TRACK=0
  vitrolinha.player_first_command.play_all_rejected:
    extra_configs:
      - CONFIG_TEST_REJECT_ALL=y
      - CONFIG_TEST_FIRST_COMMAND=0
      - CONFIG_TEST_EXPECTED_TRACK=-1
  vitrolinha.player_first_command.next:
    extra_configs:
      - CONFIG_TEST_FIRST_COMMAND=1
      - CONFIG_TEST_EXPECTED_TRACK=0
  vitrolinha.player_first_command.prev:
    extra_configs:
      - CONFIG_TEST_FIRST_COMMAND=2
      - CONFIG_TEST_EXPECTED_TRACK=1
```
