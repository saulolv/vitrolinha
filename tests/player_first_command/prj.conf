## CMakeLists.txt
```
cmake_minimum_required(VERSION 3.20.0)

find_package(Zephyr REQUIRED HINTS $ENV{ZEPHYR_BASE})
project(vitrolinha_player_first_command_test LANGUAGES C)

include(${CMAKE_CURRENT_LIST_DIR}/../vitrolinha_test.cmake)
target_sources(app PRIVATE src/main.c)
```

## Kconfig
```
# Parâmetros dos cenários deste teste, um por processo (ver testcase.yaml).
#
# O que se testa aqui só acontece uma vez por processo: o player começa sem
# faixa uma vez. Cada cenário é por isso um binário próprio.

config TEST_CARD
	bool "Varrer a biblioteca de mentira, de duas faixas, antes do comando"
	default y

config TEST_REJECT_ALL
	bool "Recusar as duas faixas depois de varrer, como se o parser as rejeitasse"

config TEST_FIRST_COMMAND
	int "Primeiro comando, como valor de enum cmd_kind"
	default 0

config TEST_EXPECTED_TRACK
	int "Faixa do instantâneo depois do comando; -1 é TRACK_NONE"
	default 0

# As opções do projeto: é delas que sai CONFIG_VITROLINHA_PLAYER, sem a qual
# src/CMakeLists.txt deixaria player e loader fora deste teste.
rsource "../../Kconfig.vitrolinha"

source "Kconfig.zephyr"
```

## prj.conf
```kconfig
CONFIG_ZTEST=y
CONFIG_ASSERT=y
CONFIG_SYS_CLOCK_TICKS_PER_SEC=20000
# O player espera comando e resultado de carga num mesmo k_poll.
CONFIG_POLL=y
# O que se testa é o primeiro comando, não o fim da faixa. Explícito porque
# o padrão do projeto é ligado, e este teste não enxergava a opção antes de
# incluir o Kconfig.vitrolinha.
CONFIG_VITROLINHA_AUTO_ADVANCE=n
```

## src/main.c
```c
/** @file main.c
 * @brief O primeiro comando do player, antes de haver faixa selecionada.
 *
 * Seguinte, anterior e tocar partem de "nenhuma faixa" de modos diferentes,
 * e com a biblioteca vazia nenhum deles tem para onde ir. Cada cenário do
 * testcase.yaml é um processo, porque o player só sai de "nenhuma faixa" uma
 * vez. A biblioteca é a de mentira, com duas faixas, varrida ou não pela
 * `library`; o que se confere é só a faixa escolhida, publicada antes da
 * carga.
 */
#include <vitrolinha/cmd.h>
#include <vitrolinha/library.h>
#include <vitrolinha/loader.h>
#include <vitrolinha/player.h>
#include <vitrolinha/snapshot.h>
#include <vitrolinha/tone.h>

#include <zephyr/ztest.h>

ZTEST(player_first_command, test_primeiro_comando_sem_faixa)
{
	struct player_snapshot snap;

	zassert_ok(loader_init());
	zassert_ok(tone_init());
	zassert_ok(player_init());
	if (!IS_ENABLED(CONFIG_TEST_CARD)) {
		/* Nada tem para onde ir. */
		zassert_ok(cmd_post(CMD_NEXT, TRACK_NONE));
		zassert_ok(cmd_post(CMD_PREV, TRACK_NONE));
		zassert_ok(cmd_post(CMD_PLAY_PAUSE, TRACK_NONE));
		zassert_ok(cmd_post(CMD_SELECT, 0));
	} else {
		zassert_equal(2, library_refresh());
		if (IS_ENABLED(CONFIG_TEST_REJECT_ALL)) {
			/* Cartão pronto, nenhuma faixa tocável. */
			zassert_ok(library_reject(0, library_generation()));
			zassert_ok(library_reject(1, library_generation()));
		}
		zassert_ok(cmd_post(CONFIG_TEST_FIRST_COMMAND, TRACK_NONE));
	}
	k_msleep(10);
	snapshot_read(&snap);
	zassert_equal(PLAYER_STOPPED, snap.state);
	zassert_equal(CONFIG_TEST_EXPECTED_TRACK, snap.track);
}

ZTEST_SUITE(player_first_command, NULL, NULL, NULL, NULL, NULL);
```
