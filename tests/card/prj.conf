## CMakeLists.txt
```
cmake_minimum_required(VERSION 3.20.0)

find_package(Zephyr REQUIRED HINTS $ENV{ZEPHYR_BASE})

project(vitrolinha_card_test LANGUAGES C)

# Exercita o backend SD sobre o mesmo FatFs/disco emulado do monitor.
set(VITROLINHA_STORAGE_SD ON)
include(${CMAKE_CURRENT_LIST_DIR}/../vitrolinha_test.cmake)

target_sources(app PRIVATE
  src/fake_disk.c
  src/main.c
)
```

## prj.conf
```kconfig
# Este teste é o único que precisa de uma pilha de disco: o módulo sob teste
# monta um volume de verdade, sobre o FatFs de verdade. O que troca é só o
# disco embaixo — um vetor em RAM em vez do cartão.
CONFIG_ZTEST=y
CONFIG_ASSERT=y
CONFIG_GPIO=y

# ----------------------------------------------------------------------------
# A pilha que o módulo atravessa
# ----------------------------------------------------------------------------
CONFIG_DISK_ACCESS=y
CONFIG_FILE_SYSTEM=y
CONFIG_FAT_FILESYSTEM_ELM=y

# O FatFs monta a lista de volumes a partir do devicetree, e aqui não há nó de
# disco nenhum — o disco é registrado em tempo de execução pelo próprio teste.
# Sem esta lista o FF_VOLUMES fica sem valor válido e o módulo não compila.
# É a mesma saída que boards/native_sim_native_64.conf usa, e o nome tem de
# ser o mesmo que o módulo deriva de CARD_MOUNT_POINT.
CONFIG_FS_FATFS_CUSTOM_MOUNT_POINT_COUNT=1
CONFIG_FS_FATFS_CUSTOM_MOUNT_POINTS="SD"

# O mesmo do firmware, e por dependência do que o teste comprova: com a
# formatação automática ligada, um volume ilegível seria FORMATADO por
# fs_mount e passaria a montar — o caso "presente e ilegivel" deixaria de
# existir, e o teste que o exige passaria a testar o oposto do firmware.
CONFIG_FS_FATFS_MOUNT_MKFS=n

# Formatar o disco de mentira uma vez, no preparo, é o que dá ao teste um
# cartão "bom" para trabalhar. O firmware não tem esta opção, de propósito:
# a biblioteca é do usuário.
CONFIG_FILE_SYSTEM_MKFS=y
CONFIG_FS_FATFS_MKFS=y

# Os mesmos do firmware.
CONFIG_FS_FATFS_NUM_FILES=2
CONFIG_FS_FATFS_NUM_DIRS=2

# ----------------------------------------------------------------------------
# Pilhas
# ----------------------------------------------------------------------------

# O fs_mkfs do FatFs põe um buffer de trabalho de FF_MAX_SS (512 B) na pilha
# de quem chama, e quem chama aqui é o preparo da suíte.
CONFIG_MAIN_STACK_SIZE=4096
CONFIG_ZTEST_STACK_SIZE=4096

# ----------------------------------------------------------------------------
# Diagnóstico
# ----------------------------------------------------------------------------

# O módulo registra as transições por LOG_INF; com o log mudo, uma falha de
# montagem não deixaria rastro nenhum na saída do teste.
CONFIG_LOG=y
CONFIG_LOG_MODE_DEFERRED=y
CONFIG_THREAD_NAME=y
```

## app.overlay
```dts
#include <zephyr/dt-bindings/gpio/gpio.h>

/ {
	sd_cd: zephyr,user {
		gpios = <&gpio0 1 GPIO_ACTIVE_LOW>;
	};
};
```

## src/main.c
```c
/**
 * @file main.c
 * @brief Testes de @ref card.h com um cartão que o teste põe e tira.
 *
 * O critério da issue #9 é "inserir e remover o cartão é detectado
 * corretamente". É uma afirmação sobre um evento físico, e é por isso que
 * existe o disco de mentira de `fake_disk.h`: sem ele, conferir isto
 * dependeria de alguém puxar o cartão da bancada na hora certa, e não valeria
 * como regressão automática nenhuma vez.
 *
 * O que estes testes exercitam é o módulo de verdade sobre o FatFs de
 * verdade — `fs_mount`, `fs_unmount` e `disk_access` são os mesmos da placa.
 * O que muda é de onde vêm os setores.
 */

#include "fake_disk.h"

#include <vitrolinha/card.h>
#include <vitrolinha/card_test.h>

#include <errno.h>
#include <string.h>

#include <zephyr/fs/fs.h>
#include <zephyr/kernel.h>
#include <zephyr/ztest.h>

/**
 * @brief Quanto esperar por uma transição do monitor.
 *
 * O monitor sonda a cada 250 ms. Um segundo dá quatro sondagens de folga, e
 * em `native_sim` o relógio é simulado: a espera não custa tempo de parede.
 */
#define SETTLE_TIMEOUT_MS 1000

/** @brief Passo da espera. Bem abaixo do intervalo do monitor. */
#define SETTLE_STEP_MS 25

/** @brief O que @ref card_init devolveu na primeira e única chamada. */
static int init_result;

/** @brief Quantas vezes o observador foi chamado desde o último preparo. */
static int observed_calls;

/** @brief O último estado que o observador viu. */
static enum card_state observed_state;

static void on_card_change(enum card_state state)
{
	observed_calls++;
	observed_state = state;
}

/**
 * @brief Espera o monitor concluir @p expected, ou desiste.
 *
 * @return O estado em que o cartão parou.
 */
static enum card_state settle(enum card_state expected)
{
	int64_t deadline = k_uptime_get() + SETTLE_TIMEOUT_MS;

	while ((card_get_state() != expected) && (k_uptime_get() < deadline)) {
		k_msleep(SETTLE_STEP_MS);
	}

	return card_get_state();
}

static void *card_setup(void)
{
	zassert_ok(fake_disk_setup(), "o disco de mentira nao subiu");

	card_observe(on_card_change);
	init_result = card_init();

	return NULL;
}

/**
 * @brief Todo caso começa com o soquete vazio, sem falhas e sem histórico.
 *
 * A volta ao estado inicial é feita por @ref card_refresh e não esperando o
 * monitor: o preparo não é o que se está medindo, e chamar direto torna o
 * ponto de partida determinístico.
 */
static void card_before(void *fixture)
{
	ARG_UNUSED(fixture);

	card_observe(on_card_change);
	fake_disk_reset();

	zassert_equal(CARD_ABSENT, card_refresh(), "preparo nao devolveu ao soquete vazio");

	observed_calls = 0;
	observed_state = CARD_ABSENT;
}

ZTEST_SUITE(card, NULL, card_setup, card_before, NULL, NULL);

/* -------------------------------------------------------------------------
 * Inicialização
 * ------------------------------------------------------------------------- */

ZTEST(card, test_init_sobe_o_monitor)
{
	zassert_ok(init_result, "card_init devolveu %d", init_result);
}

ZTEST(card, test_init_nao_cria_um_segundo_monitor)
{
	/* Duas threads sondando o mesmo soquete e montando o mesmo volume
	 * seria o pior tipo de bug: intermitente e só na placa.
	 */
	zassert_equal(-EALREADY, card_init());
}

ZTEST(card, test_soquete_vazio_e_ausente)
{
	zassert_equal(CARD_ABSENT, card_get_state());
	zassert_not_equal(CARD_READY, card_get_state());
}

ZTEST(card, test_sem_disco_registrado_o_cartao_e_ausente)
{
	/* É a situação do alvo de simulação do firmware: nenhum nó
	 * `zephyr,sdmmc-disk` no devicetree, `disk_access_status` devolvendo
	 * erro. Tem de virar "ausente", e não falha de inicialização.
	 */
	fake_disk_register(false);
	fake_disk_insert(true);

	zassert_equal(CARD_ABSENT, card_refresh());
	zassert_not_equal(CARD_READY, card_get_state());
}

/* -------------------------------------------------------------------------
 * Inserção e remoção
 * ------------------------------------------------------------------------- */

ZTEST(card, test_insercao_e_detectada_pelo_monitor)
{
	fake_disk_insert(true);

	zassert_equal(CARD_READY, settle(CARD_READY), "o monitor nao viu a insercao");
	zassert_equal(CARD_READY, card_get_state());
	zassert_equal(1, observed_calls, "o observador tinha de ser avisado uma vez");
	zassert_equal(CARD_READY, observed_state);
}

ZTEST(card, test_remocao_e_detectada_pelo_monitor)
{
	fake_disk_insert(true);
	zassert_equal(CARD_READY, settle(CARD_READY));

	fake_disk_insert(false);

	zassert_equal(CARD_ABSENT, settle(CARD_ABSENT), "o monitor nao viu a remocao");
	zassert_not_equal(CARD_READY, card_get_state());
	zassert_equal(2, observed_calls, "insercao e remocao, uma notificacao cada");
	zassert_equal(CARD_ABSENT, observed_state);
}

ZTEST(card, test_cartao_parado_nao_gera_notificacao)
{
	fake_disk_insert(true);
	zassert_equal(CARD_READY, settle(CARD_READY));

	/* Várias sondagens do monitor com o cartão no mesmo estado. O
	 * observador é de transição, não de amostragem: a interface não pode
	 * redesenhar a tela quatro vezes por segundo à toa.
	 */
	k_msleep(SETTLE_TIMEOUT_MS);

	zassert_equal(1, observed_calls, "notificou %d vezes sem nada mudar",
		      observed_calls);
	zassert_equal(CARD_READY, card_get_state());
}

ZTEST(card, test_refresh_nao_espera_a_cadencia_do_monitor)
{
	fake_disk_insert(true);

	/* Sem dormir: quem chama pode forçar a avaliação em vez de esperar os
	 * 250 ms da sondagem.
	 */
	zassert_equal(CARD_READY, card_refresh());
}

/* -------------------------------------------------------------------------
 * Cartão presente e ilegível
 * ------------------------------------------------------------------------- */

ZTEST(card, test_cartao_que_nao_inicializa_fica_ilegivel)
{
	fake_disk_fail_init(true);
	fake_disk_insert(true);

	/* Presente e ilegível, não ausente: o soquete não está vazio, e a
	 * mensagem na tela é outra.
	 */
	zassert_equal(CARD_UNREADABLE, settle(CARD_UNREADABLE));
	zassert_not_equal(CARD_READY, card_get_state());
}

ZTEST(card, test_volume_que_nao_monta_fica_ilegivel)
{
	fake_disk_fail_read(true);
	fake_disk_insert(true);

	zassert_equal(CARD_UNREADABLE, settle(CARD_UNREADABLE));
	zassert_not_equal(CARD_READY, card_get_state());
}

ZTEST(card, test_ilegivel_nao_e_tentado_de_novo_no_soquete)
{
	fake_disk_fail_read(true);
	fake_disk_insert(true);
	zassert_equal(CARD_UNREADABLE, settle(CARD_UNREADABLE));

	/* O cartão "melhora" sem sair do soquete. Um volume não se conserta
	 * sozinho, então o módulo não tem por que descobrir isso: insistir a
	 * cada 250 ms gastaria barramento para sempre.
	 */
	fake_disk_fail_read(false);
	k_msleep(SETTLE_TIMEOUT_MS);

	zassert_equal(CARD_UNREADABLE, card_get_state(),
		      "voltou a tentar montar sem o cartao ter saido");
}

ZTEST(card, test_reinsercao_tenta_montar_de_novo)
{
	fake_disk_fail_read(true);
	fake_disk_insert(true);
	zassert_equal(CARD_UNREADABLE, settle(CARD_UNREADABLE));

	/* Tirar e pôr é o gesto que pede nova tentativa — e é o único. */
	fake_disk_insert(false);
	zassert_equal(CARD_ABSENT, settle(CARD_ABSENT));

	fake_disk_fail_read(false);
	fake_disk_insert(true);

	zassert_equal(CARD_READY, settle(CARD_READY), "a reinsercao nao remontou");
}

ZTEST(card, test_cartao_ruim_seguido_de_bom_monta)
{
	/* A armadilha que este caso guarda: quando `fs_mount` falha DEPOIS de
	 * inicializar o cartão, ninguém desfaz essa inicialização, e a pilha
	 * SD segue achando que o cartão está pronto. Sem o release explícito,
	 * o FatFs pularia a inicialização do cartão seguinte e leria lixo.
	 */
	fake_disk_fail_read(true);
	fake_disk_insert(true);
	zassert_equal(CARD_UNREADABLE, settle(CARD_UNREADABLE));

	fake_disk_insert(false);
	zassert_equal(CARD_ABSENT, settle(CARD_ABSENT));

	fake_disk_fail_read(false);
	fake_disk_insert(true);
	zassert_equal(CARD_READY, settle(CARD_READY));

	/* E o cartão bom tem de continuar montável depois de uma volta
	 * inteira, o que só acontece se a contagem de referências do disco
	 * tiver fechado.
	 */
	fake_disk_insert(false);
	zassert_equal(CARD_ABSENT, settle(CARD_ABSENT));

	fake_disk_insert(true);
	zassert_equal(CARD_READY, settle(CARD_READY));
}

/* -------------------------------------------------------------------------
 * Remoção a quente
 * ------------------------------------------------------------------------- */

ZTEST(card, test_desmontagem_que_falha_nao_prende_o_cartao)
{
	fake_disk_insert(true);
	zassert_equal(CARD_READY, settle(CARD_READY));

	/* A desmontagem que não completa é o que a issue zephyr#94033
	 * descreve, fechada como "not planned". O módulo tem de seguir como
	 * desmontado: continuar achando que o volume está montado bloquearia
	 * para sempre a próxima montagem.
	 */
	fake_disk_fail_deinit(true);
	fake_disk_insert(false);

	zassert_equal(CARD_ABSENT, settle(CARD_ABSENT));

	fake_disk_fail_deinit(false);
	fake_disk_insert(true);

	zassert_equal(CARD_READY, settle(CARD_READY),
		      "ficou preso achando que o volume continuava montado");
}

/* -------------------------------------------------------------------------
 * Empréstimo do volume
 * ------------------------------------------------------------------------- */

ZTEST(card, test_emprestimo_com_soquete_vazio)
{
	/* Nada a emprestar, e nada a devolver: quem recebe erro não chama
	 * card_release. É daqui que o storage tira o -ENODEV do contrato.
	 */
	zassert_equal(-ENODEV, card_acquire());
}

ZTEST(card, test_emprestimo_com_volume_ilegivel)
{
	fake_disk_fail_read(true);
	fake_disk_insert(true);
	zassert_equal(CARD_UNREADABLE, settle(CARD_UNREADABLE));

	/* Presente e ilegível pede outra mensagem na tela que soquete vazio,
	 * e o código de erro é o que carrega a diferença.
	 */
	zassert_equal(-EIO, card_acquire());
}

ZTEST(card, test_emprestimo_com_cartao_pronto)
{
	fake_disk_insert(true);
	zassert_equal(CARD_READY, settle(CARD_READY));

	zassert_ok(card_acquire());
	card_release();
}

ZTEST(card, test_monitor_nao_desmonta_durante_o_emprestimo)
{
	fake_disk_insert(true);
	zassert_equal(CARD_READY, settle(CARD_READY));

	zassert_ok(card_acquire());

	/* O cartão sai no meio de uma leitura. O FatFs roda sem reentrância:
	 * desmontar agora zeraria o objeto de trabalho do volume por baixo de
	 * quem o está usando. O monitor tem de esperar a devolução.
	 */
	fake_disk_insert(false);
	k_msleep(SETTLE_TIMEOUT_MS);

	zassert_equal(CARD_READY, card_get_state(),
		      "o monitor desmontou um volume emprestado");

	card_release();

	zassert_equal(CARD_ABSENT, settle(CARD_ABSENT),
		      "a remocao nao foi vista depois da devolucao");
}

/* -------------------------------------------------------------------------
 * Observador
 * ------------------------------------------------------------------------- */

ZTEST(card, test_observador_pode_ser_desligado)
{
	card_observe(NULL);

	fake_disk_insert(true);

	zassert_equal(CARD_READY, settle(CARD_READY), "o monitor parou junto com o aviso");
	zassert_equal(0, observed_calls, "avisou mesmo depois de desligado");
}

/* -------------------------------------------------------------------------
 * Nomes
 * ------------------------------------------------------------------------- */

ZTEST(card, test_nome_de_cada_estado)
{
	/* Os três nomes do CONTEXT.md, que é o vocabulário que vai para a
	 * tela e para o relatório.
	 */
	zassert_str_equal("ausente", card_state_name(CARD_ABSENT));
	zassert_str_equal("presente e legivel", card_state_name(CARD_READY));
	zassert_str_equal("presente e ilegivel", card_state_name(CARD_UNREADABLE));
}

ZTEST(card, test_nome_de_estado_fora_da_enumeracao)
{
	/* Vale mais um texto inútil no log do que uma leitura fora da tabela
	 * por causa de um valor que não deveria existir.
	 */
	zassert_str_equal("desconhecido", card_state_name((enum card_state)99));
}

ZTEST(card, test_ponto_de_montagem_e_o_volume_do_fatfs)
{
	/* A barra é do subsistema de arquivos, os dois-pontos são do FatFs, e
	 * o nome no meio é o do disco.
	 */
	zassert_str_equal("SD", CARD_DISK_NAME);
	zassert_str_equal("/SD:", CARD_MOUNT_POINT);
}

ZTEST(card, test_volume_montado_e_navegavel)
{
	struct fs_dir_t dir;

	/* Montar não basta: sem os dois-pontos no ponto de montagem, o
	 * fs_mount dá certo e todo caminho dentro do volume falha. Este é o
	 * caso que só um acesso de verdade pega.
	 */
	fake_disk_insert(true);
	zassert_equal(CARD_READY, settle(CARD_READY));

	fs_dir_t_init(&dir);
	zassert_ok(fs_opendir(&dir, CARD_MOUNT_POINT), "o volume montou mas nao abre");
	zassert_ok(fs_closedir(&dir));
}
```

## src/fake_disk.c
```c
/**
 * @file fake_disk.c
 * @brief O cartão de mentira: 1 MiB em RAM com soquete e falhas comandáveis.
 *
 * @see fake_disk.h para o porquê, e para a máquina de estados que ele imita
 */

#include "fake_disk.h"

#include <vitrolinha/card.h>

#include <zephyr/drivers/disk.h>
#include <zephyr/drivers/gpio.h>
#include <zephyr/drivers/gpio/gpio_emul.h>
#include <zephyr/fs/fs.h>
#include <zephyr/kernel.h>
#include <zephyr/storage/disk_access.h>

#include <errno.h>
#include <string.h>

/** @brief Setor de 512 B, como todo cartão SDHC. */
#define SECTOR_SIZE 512U

/**
 * @brief Capacidade: 1 MiB.
 *
 * Grande o bastante para o `f_mkfs` produzir um volume válido, pequeno o
 * bastante para caber num vetor estático. A geometria não importa aqui, ao
 * contrário da bancada do RNF03: este teste não conta setores, só quer um
 * volume que monte.
 */
#define SECTOR_COUNT 2048U

/** @brief O conteúdo do cartão. Sobrevive a tirar e pôr. */
static uint8_t sectors[SECTOR_COUNT][SECTOR_SIZE];

/** @brief O disco está ligado ao `disk_access`? */
static bool registered;

/** @brief Há cartão no soquete? */
static bool inserted;

/** @brief O cartão já passou pelo CTRL_INIT? */
static bool initialized;

static bool failing_init;
static bool failing_read;
static bool failing_deinit;
static uint32_t status_calls;
static const struct gpio_dt_spec card_detect = GPIO_DT_SPEC_GET(DT_NODELABEL(sd_cd), gpios);

static int fake_init(struct disk_info *disk)
{
	ARG_UNUSED(disk);

	if (!inserted) {
		return DISK_STATUS_NOMEDIA;
	}

	if (failing_init) {
		return -EIO;
	}

	initialized = true;

	return 0;
}

static int fake_status(struct disk_info *disk)
{
	ARG_UNUSED(disk);
	status_calls++;

	if (!inserted) {
		return DISK_STATUS_NOMEDIA;
	}

	return initialized ? DISK_STATUS_OK : DISK_STATUS_UNINIT;
}

static int fake_read(struct disk_info *disk, uint8_t *buf, uint32_t start, uint32_t count)
{
	ARG_UNUSED(disk);

	if (!inserted || failing_read) {
		return -EIO;
	}

	if ((uint64_t)start + count > SECTOR_COUNT) {
		return -EIO;
	}

	(void)memcpy(buf, sectors[start], (size_t)count * SECTOR_SIZE);

	return 0;
}

static int fake_write(struct disk_info *disk, const uint8_t *buf, uint32_t start, uint32_t count)
{
	ARG_UNUSED(disk);

	if (!inserted) {
		return -EIO;
	}

	if ((uint64_t)start + count > SECTOR_COUNT) {
		return -EIO;
	}

	(void)memcpy(sectors[start], buf, (size_t)count * SECTOR_SIZE);

	return 0;
}

static int fake_ioctl(struct disk_info *disk, uint8_t cmd, void *buf)
{
	switch (cmd) {
	case DISK_IOCTL_GET_SECTOR_COUNT:
		*(uint32_t *)buf = SECTOR_COUNT;
		break;
	case DISK_IOCTL_GET_SECTOR_SIZE:
		*(uint32_t *)buf = SECTOR_SIZE;
		break;
	case DISK_IOCTL_GET_ERASE_BLOCK_SZ:
		*(uint32_t *)buf = 1U;
		break;
	case DISK_IOCTL_CTRL_SYNC:
		break;
	case DISK_IOCTL_CTRL_INIT:
		return fake_init(disk);
	case DISK_IOCTL_CTRL_DEINIT:
		initialized = false;
		return failing_deinit ? -EIO : 0;
	default:
		return -EINVAL;
	}

	return 0;
}

static const struct disk_operations fake_ops = {
	.init = fake_init,
	.status = fake_status,
	.read = fake_read,
	.write = fake_write,
	.ioctl = fake_ioctl,
};

static struct disk_info fake_disk = {
	/* O mesmo disk-name do sdhc0, sem os delimitadores do caminho FAT. */
	.name = CARD_DISK_NAME,
	.ops = &fake_ops,
};

int fake_disk_setup(void)
{
	bool force = true;
	int err;

	err = gpio_pin_configure_dt(&card_detect, GPIO_INPUT);
	if (err != 0) {
		return err;
	}
	fake_disk_register(true);

	/* Formatar exige cartão no soquete. O `dev_id` do FatFs é a string do
	 * volume, sem a barra inicial que o subsistema de arquivos exige no
	 * ponto de montagem.
	 */
	inserted = true;

	err = fs_mkfs(FS_FATFS, (uintptr_t)(CARD_MOUNT_POINT + 1), NULL, 0);
	if (err != 0) {
		return err;
	}

	/* A formatação inicializou o disco e ninguém a desfez. Zerar a
	 * contagem de referências aqui é o que faz cada teste começar do mesmo
	 * lugar, em vez de herdar um `+1` do preparo.
	 */
	(void)disk_access_ioctl(CARD_DISK_NAME, DISK_IOCTL_CTRL_DEINIT, &force);

	fake_disk_reset();

	return 0;
}

void fake_disk_register(bool present)
{
	if (present == registered) {
		return;
	}

	if (present) {
		(void)disk_access_register(&fake_disk);
	} else {
		(void)disk_access_unregister(&fake_disk);
	}

	registered = present;
}

void fake_disk_insert(bool present)
{
	inserted = present;
	int err = gpio_emul_input_set(card_detect.port, card_detect.pin, !present);

	__ASSERT_NO_MSG(err == 0);
}

uint32_t fake_disk_status_calls(void)
{
	return status_calls;
}

void fake_disk_fail_init(bool failing)
{
	failing_init = failing;
}

void fake_disk_fail_read(bool failing)
{
	failing_read = failing;
}

void fake_disk_fail_deinit(bool failing)
{
	failing_deinit = failing;
}

void fake_disk_reset(void)
{
	fake_disk_register(true);

	fake_disk_insert(false);
	failing_init = false;
	failing_read = false;
	failing_deinit = false;
}
```

## src/fake_disk.h
```c
/**
 * @file fake_disk.h
 * @brief Um cartão que o teste segura na mão: entra, sai, e falha sob encomenda.
 *
 * Registra no `disk_access` um disco chamado `"SD"` — o mesmo nome do nó
 * `sdhc0` da ZBook — respaldado por um vetor em RAM. A partir daí o módulo
 * `card` sob teste não tem como saber que não é um cartão: ele fala com o
 * `disk_access` e com o FatFs, exatamente como na placa.
 *
 * É isto que torna a issue #9 testável. "Inserir e remover o cartão é
 * detectado corretamente" é um critério sobre um evento físico; reproduzi-lo
 * na bancada depende de alguém puxar o cartão na hora certa, e não é
 * reproduzível em CI de jeito nenhum.
 *
 * O disco imita a máquina de estados do driver de verdade
 * (`zephyr/drivers/disk/sdmmc_subsys.c`): sem mídia devolve
 * `DISK_STATUS_NOMEDIA`, com mídia e sem inicializar devolve
 * `DISK_STATUS_UNINIT`, e só depois do `DISK_IOCTL_CTRL_INIT` devolve
 * `DISK_STATUS_OK`. Não é capricho — é essa transição que faz o FatFs
 * inicializar o cartão na montagem e liberá-lo na desmontagem, e é ela que o
 * `card` usa para descobrir que o soquete esvaziou.
 */

#ifndef VITROLINHA_TEST_FAKE_DISK_H_
#define VITROLINHA_TEST_FAKE_DISK_H_

#include <stdbool.h>
#include <stdint.h>

#ifdef __cplusplus
extern "C" {
#endif

/**
 * @brief Registra o disco e formata o volume, com o soquete vazio.
 *
 * Formatar uma vez no início é o que permite ao teste ter um cartão "bom" —
 * o firmware nunca formata, e `CONFIG_FS_FATFS_MOUNT_MKFS` fica desligado
 * aqui como no firmware, justamente para que um volume ruim continue ruim.
 *
 * @return 0, ou erro negativo de `disk_access_register` ou `fs_mkfs`.
 */
int fake_disk_setup(void);

/**
 * @brief Liga ou desliga o disco do `disk_access`.
 *
 * Desligado, `disk_access_status` responde erro em vez de estado — que é o
 * que acontece quando o devicetree não tem nó `zephyr,sdmmc-disk` nenhum. É
 * exatamente a situação do alvo de simulação do firmware, e o módulo tem de
 * concluir "ausente" em vez de tratar como falha.
 */
void fake_disk_register(bool registered);

/**
 * @brief Põe ou tira o cartão do soquete.
 *
 * Atualiza a resposta de disk_access_status e o GPIO emulado de card-detect,
 * disparando sua interrupção, sem apagar o conteúdo do volume — tirar e
 * pôr o mesmo cartão devolve o mesmo cartão.
 */
void fake_disk_insert(bool inserted);

/** @brief Número de consultas de status, para verificar ausência de polling. */
uint32_t fake_disk_status_calls(void);

/**
 * @brief Faz o cartão recusar a inicialização.
 *
 * Cartão presente cujo `CTRL_INIT` falha: meio físico inacessível. A
 * montagem nem chega a ler setor nenhum.
 */
void fake_disk_fail_init(bool failing);

/**
 * @brief Faz toda leitura falhar.
 *
 * Cartão que inicializa e depois não entrega setor: o `f_mount` quebra ao
 * ler o setor de arranque. É o caminho por onde o volume ilegível aparece
 * sem que o meio físico esteja ausente.
 */
void fake_disk_fail_read(bool failing);

/**
 * @brief Faz o `DISK_IOCTL_CTRL_DEINIT` falhar.
 *
 * Reproduz a desmontagem que não completa — o que a issue zephyr#94033
 * descreve na remoção a quente. Serve para conferir que o módulo segue em
 * frente em vez de ficar preso achando que o volume continua montado.
 */
void fake_disk_fail_deinit(bool failing);

/**
 * @brief Devolve o disco ao `disk_access`, esvazia o soquete e tira as falhas.
 *
 * Não desfaz a formatação: o volume continua válido.
 */
void fake_disk_reset(void);

#ifdef __cplusplus
}
#endif

#endif /* VITROLINHA_TEST_FAKE_DISK_H_ */
```
